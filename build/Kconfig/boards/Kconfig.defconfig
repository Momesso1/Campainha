## build/Kconfig/boards/Kconfig.defconfig
```kconfig
# Load Zephyr board defconfig descriptions.
osource "/home/momesso/zephyrproject/zephyr/boards/espressif/esp32c3_devkitm/Kconfig.defconfig"
```

## build/Kconfig/boards/Kconfig.esp32c3_devkitm
```kconfig
# Load board Kconfig descriptions.
osource "/home/momesso/zephyrproject/zephyr/boards/espressif/esp32c3_devkitm/Kconfig.esp32c3_devkitm"
```

## build/Kconfig/boards/Kconfig.sysbuild
```kconfig
# Load Sysbuild board Kconfig descriptions.
osource "/home/momesso/zephyrproject/zephyr/boards/espressif/esp32c3_devkitm/Kconfig.sysbuild"
```

## tests/button/testcase.yaml
```yaml
tests:
  app.button:
    platform_allow:
      - native_sim
      - native_sim/native/64
    tags: button zbus gpio
```

## twister-out.4/native_sim_native/host_gnu/campainha_silenciosa/tests/button/app.button/Kconfig/boards/Kconfig
```kconfig
# Load Zephyr board Kconfig descriptions.
osource "/home/momesso/zephyrproject/zephyr/boards/native/native_sim/Kconfig"
```

## twister-out.5/native_sim_native/host_gnu/campainha_silenciosa/tests/button/app.button/Kconfig/arch/Kconfig
```kconfig
# Load Zephyr Arch Kconfig descriptions.
osource "/home/momesso/zephyrproject/zephyr/arch/rx/Kconfig"
osource "/home/momesso/zephyrproject/zephyr/arch/x86/Kconfig"
osource "/home/momesso/zephyrproject/zephyr/arch/xtensa/Kconfig"
osource "/home/momesso/zephyrproject/zephyr/arch/sparc/Kconfig"
osource "/home/momesso/zephyrproject/zephyr/arch/riscv/Kconfig"
osource "/home/momesso/zephyrproject/zephyr/arch/posix/Kconfig"
osource "/home/momesso/zephyrproject/zephyr/arch/openrisc/Kconfig"
osource "/home/momesso/zephyrproject/zephyr/arch/mips/Kconfig"
osource "/home/momesso/zephyrproject/zephyr/arch/arm64/Kconfig"
osource "/home/momesso/zephyrproject/zephyr/arch/arm/Kconfig"
osource "/home/momesso/zephyrproject/zephyr/arch/arc/Kconfig"
```

## twister-out.5/native_sim_native/host_gnu/campainha_silenciosa/tests/hist/app.hist/Kconfig/boards/Kconfig.defconfig
```kconfig
# Load Zephyr board defconfig descriptions.
osource "/home/momesso/zephyrproject/zephyr/boards/native/native_sim/Kconfig.defconfig"
```

## twister-out.5/native_sim_native/host_gnu/campainha_silenciosa/tests/hist/app.hist/Kconfig/boards/Kconfig.native_sim
```kconfig
# Load board Kconfig descriptions.
osource "/home/momesso/zephyrproject/zephyr/boards/native/native_sim/Kconfig.native_sim"
```
